/dts-v1/;
/plugin/;

/ {
    fragment@0 {
        target = <&i2c1>;
        __overlay__ {
            #address-cells = <1>;
            #size-cells = <0>;

            cardkb@5f {
                compatible = "openai,cardkb";
                reg = <0x5f>;
                status = "okay";
            };
        };
    };
};


